/dts-v1/;/plugin/;
/ {
    fragment@0 {
        target-path = "/amba";
        #address-celss = <1>;
        #size-cells = <0>;
        __overlay__ {
            v4l2 {
                compatible = "fixstars,zynq-v4l2-1.0";
                #interrupt-cells = <0x3>;
                device-name="v4l2";
                interrupt-parent = <4>;
                interrupts = <0x0 0x1d 0x4>;
            };
        };
    };
};
