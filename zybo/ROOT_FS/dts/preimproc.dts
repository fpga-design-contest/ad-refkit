/dts-v1/;/plugin/;
/ {
    fragment@0 {
        target-path = "/amba";
        __overlay__ {
            #address-cells = <0x1>;
            #size-cells = <0x1>;
            preimproc_0: preimproc@43c30000 {
                compatible = "generic-uio";
                reg = <0x43c30000 0x10000>;
            };
        };
    };
};